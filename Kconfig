## Kconfig
```kconfig
# Copyright (c) 2026 Bayrem Gharsellaoui
# SPDX-License-Identifier: Apache-2.0

rsource "drivers/Kconfig"
```

## drivers/pn532/Kconfig
```kconfig
# Copyright (c) 2026 Bayrem Gharsellaoui
# SPDX-License-Identifier: Apache-2.0

menuconfig PN532
    bool "PN532 device drivers"
    help
      This option enables the pn532 custom driver class.

if PN532

config PN532_LOG_LEVEL
    int "PN532 log level"
    depends on PN532
    range 0 4
    default 3
    help
      Log level for the PN532 driver (0=off, 1=error, 2=warning, 3=info, 4=debug).

config PN532_INIT_PRIORITY
    int "PN532 device drivers init priority"
    default KERNEL_INIT_PRIORITY_DEVICE
    help
      PN532 device drivers init priority.

config EMUL_PN532
  bool "Emulate a PN532 module"
  default y
  depends on EMUL
  depends on PN532
  help
    It provides emulated I2C for testing purposes.

module = PN532
module-str = pn532
source "subsys/logging/Kconfig.template.log_config"

endif # PN532
```

## dts/bindings/nxp,pn532.yaml
```yaml
# Copyright (c) 2026 Bayrem Gharsellaoui
# SPDX-License-Identifier: Apache-2.0

description: |
  NXP PN532 NFC controller connected over UART (HSU mode).
  Supports communication with NFC tags and devices.

compatible: "nxp,pn532"

include: [base.yaml, uart-device.yaml]

properties:
  irq-gpios:
    type: phandle-array
    required: false
    description: |
      Optional IRQ line from the PN532 indicating data ready.

  reset-gpios:
    type: phandle-array
    required: false
    description: |
      Optional reset pin for the PN532.
```

## tests/drivers/pn532/testcase.yaml
```yaml
# Copyright (c) 2026 Bayrem Gharsellaoui
# SPDX-License-Identifier: Apache-2.0

tests:
  driver.pn532:
    platform_allow:
      - native_sim
    integration_platforms:
      - native_sim
    tags:
      - drivers
      - pn532
```

## west.yml
```yaml
# Copyright (c) 2026 Bayrem Gharsellaoui
# SPDX-License-Identifier: Apache-2.0

manifest:

  projects:
    - name: zephyr
      url: https://github.com/zephyrproject-rtos/zephyr
      revision: v4.3.0
      import:
        name-allowlist:
          - cmsis_6
          - hal_stm32

  self:
    path: pn532
```
