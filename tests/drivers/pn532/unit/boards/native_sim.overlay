/*
 * Copyright (c) 2026 Bayrem Gharsellaoui
 * SPDX-License-Identifier: Apache-2.0
 */

&uart1 {
    status = "okay";
    /* Using native-pty-uart here just to avoid CI failing */
    compatible = "zephyr,native-pty-uart";
    current-speed = <115200>;

    pn532 {
        compatible = "nxp,pn532";
        /* No IRQ or Reset pin used in native_sim */
    };
};